## Kconfig
```kconfig
#
# AVL6261 dvb driver configuration
#

menu "AVL6261 dvb driver"

config AVL6261
	tristate "AVL6261 dvb driver"
	default m
	select DVB_CORE
	help
		Select to enable AVL6261 dvb driver.
endmenu
```

## dvb-avl/Kconfig
```kconfig
#
# AVL DVB driver configuration
#

menu "Availink DVB drivers"

config AVLDVB
	tristate "AVL DVB drivers"
	default m
	select DVB_CORE
	help
		Select to enable AVL DVB drivers.


endmenu
```
